## firmware/sdkconfig.defaults
```kconfig
# ── Target ────────────────────────────────────────────────────────────────────
CONFIG_IDF_TARGET="esp32s3"

# ── Flash / partition table ────────────────────────────────────────────────────
CONFIG_ESPTOOLPY_FLASHSIZE_8MB=y
CONFIG_PARTITION_TABLE_CUSTOM=y
CONFIG_PARTITION_TABLE_CUSTOM_FILENAME="partitions.csv"

# ── SPIFFS ─────────────────────────────────────────────────────────────────────
CONFIG_SPIFFS_OBJ_NAME_LEN=64

# ── PSRAM (OPI on XIAO ESP32-S3 Sense) ────────────────────────────────────────
CONFIG_SPIRAM=y
CONFIG_SPIRAM_MODE_OCT=y
CONFIG_SPIRAM_SPEED_80M=y
CONFIG_SPIRAM_BOOT_INIT=y
CONFIG_SPIRAM_IGNORE_NOTFOUND=n
CONFIG_SPIRAM_USE_MALLOC=y
CONFIG_SPIRAM_MALLOC_ALWAYSINTERNAL=16384
CONFIG_SPIRAM_ALLOW_BSS_SEG_EXTERNAL_MEMORY=y

# ── USB serial (TinyUSB CDC via USB-OTG, owned entirely by Arduino) ──────────
# IDF console is NONE so Arduino's initArduino() is the sole owner of the
# TinyUSB stack. ARDUINO_USB_CDC_ON_BOOT=1 + ARDUINO_USB_MODE=0 (set in
# CMakeLists.txt compile defines) map Serial → USBSerial (TinyUSB CDC).
CONFIG_TINYUSB_CDC_ENABLED=y
CONFIG_ESP_CONSOLE_NONE=y
CONFIG_ESP_CONSOLE_SECONDARY_NONE=y

# ── FreeRTOS ───────────────────────────────────────────────────────────────────
CONFIG_FREERTOS_HZ=1000

# ── Arduino core ──────────────────────────────────────────────────────────────
# AUTOSTART_ARDUINO=y: framework's app_main() handles Serial.begin(), USB.begin(),
# initArduino(), and loopTask creation. Our setup()/loop() are called by loopTask.
CONFIG_AUTOSTART_ARDUINO=y
CONFIG_ARDUINO_LOOP_STACK_SIZE=32768

# ── WiFi buffers (matches ESP-NOW + WS load) ──────────────────────────────────
CONFIG_ESP_WIFI_STATIC_RX_BUFFER_NUM=10
CONFIG_ESP_WIFI_DYNAMIC_RX_BUFFER_NUM=32
CONFIG_ESP_WIFI_STATIC_TX_BUFFER_NUM=16

# ── TLS (needed by ESPAsyncWebServer) ─────────────────────────────────────────
CONFIG_MBEDTLS_SSL_MAX_CONTENT_LEN=16384
CONFIG_MBEDTLS_CERTIFICATE_BUNDLE=y

# ── Compiler ──────────────────────────────────────────────────────────────────
CONFIG_COMPILER_CXX_EXCEPTIONS=y
CONFIG_COMPILER_CXX_RTTI=y
```
